## u-boot-2016.11/board/samsung/lzw2440/Kconfig
```kconfig
if TARGET_LZW2440

config SYS_BOARD
	default "lzw2440"

config SYS_VENDOR
	default "samsung"

config SYS_SOC
	default "s3c24x0"

config SYS_CONFIG_NAME
	default "lzw2440"

endif
```
